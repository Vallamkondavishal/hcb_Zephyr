## boards/arm/hcb/Kconfig.board
```kconfig
# HCB board configuration

# Copyright (c) 2017 I-SENSE group of ICCS
# SPDX-License-Identifier: Apache-2.0

config BOARD_HCB
	bool "HCB Development Board"
	depends on SOC_STM32F303XC
```

## boards/arm/hcb/Kconfig.defconfig
```kconfig
# HCB board configuration

# Copyright (c) 2017 I-SENSE group of ICCS
# SPDX-License-Identifier: Apache-2.0

if BOARD_HCB

config BOARD
	default "hcb"
endif # BOARD_HCB
```

## boards/arm/hcb/hcb_defconfig
```kconfig
CONFIG_SPI=y
CONFIG_SYS_CLOCK_HW_CYCLES_PER_SEC=72000000
CONFIG_GPIO=y
CONFIG_CLOCK_CONTROL=y
CONFIG_SYS_CLOCK_TICKS_PER_SEC=1000
CONFIG_SOC_SERIES_STM32F3X=y
CONFIG_SOC_STM32F303XC=y
CONFIG_INIT_STACKS=y
CONFIG_CONSOLE=y
CONFIG_UART_CONSOLE=y
CONFIG_SPI_ASYNC=y
CONFIG_SPI_SLAVE=y
CONFIG_SPI_1=y
CONFIG_SPI_STM32_INTERRUPT=y
CONFIG_PWM=y
CONFIG_PWM_SHELL=y
CONFIG_PINMUX=y
CONFIG_CLOCK_STM32_SYSCLK_SRC_PLL=y
CONFIG_CLOCK_STM32_HSE_CLOCK=12000000
CONFIG_CLOCK_STM32_PLL_SRC_HSE=y
CONFIG_CLOCK_STM32_PLL_PREDIV=2
CONFIG_CLOCK_STM32_PLL_MULTIPLIER=12
CONFIG_CLOCK_STM32_APB1_PRESCALER=2
CONFIG_CLOCK_STM32_APB2_PRESCALER=2
CONFIG_USB=y
CONFIG_HWINFO_SHELL=y
CONFIG_CPLUSPLUS=y
CONFIG_STD_CPP14=y
CONFIG_LOG=y
CONFIG_SHELL=y
CONFIG_SHELL_PROMPT_UART="hcb:~$ "
CONFIG_SHELL_STACK_SIZE=1024
CONFIG_SHELL_HISTORY_BUFFER=128
CONFIG_KERNEL_SHELL=y
CONFIG_DEVICE_SHELL=y
CONFIG_USB_DEVICE_STACK=y
CONFIG_USB_DEVICE_MANUFACTURER="SWHARD"
CONFIG_USB_DEVICE_PRODUCT="HCB"
CONFIG_USB_DEVICE_HID=y
CONFIG_CAN=y
CONFIG_CAN_SHELL=y
```
